## behaviors/Kconfig
```kconfig
config ZMK_BEHAVIOR_BOOTLOADER
    bool "OCDMK bootloader jump behavior"
    default y
    depends on RETENTION_BOOT_MODE
```

## boards/ocdmk/ocdmk_core/Kconfig.defconfig
```kconfig
# OCDMK Core Board Default Configuration
# Copyright (c) 2024 OCDMK Contributors
# SPDX-License-Identifier: MIT

if BOARD_OCDMK_CORE

config ZMK_KEYBOARD_NAME
    default "OCDMK"

config USB_DEVICE_PRODUCT
    default "OCDMK Core"

config USB_DEVICE_VID
    default 0x1D50

config USB_DEVICE_PID
    default 0x615E

config USB_DEVICE_MANUFACTURER
    default "OCDMK"

if ZMK_BACKLIGHT

config PWM
    default y

config LED_PWM
    default y

endif # ZMK_BACKLIGHT

if OCDMK_DEBUG

config DEBUG
    default y

config DEBUG_INFO
    default y

config LOG
    default y

config USE_SEGGER_RTT
    default y

config LOG_BACKEND_RTT
    default y

config LOG_BACKEND_UART
    default n

config LOG_PRINTK
    default n

config SEGGER_RTT_BUFFER_SIZE_UP
    default 8096

choice SEGGER_RTT_MODE
    default SEGGER_RTT_MODE_BLOCK_IF_FIFO_FULL
endchoice

config LOG_BUFFER_SIZE
    default 2048

config STACK_SENTINEL
    default y

config THREAD_STACK_INFO
    default y

endif # OCDMK_DEBUG

endif # BOARD_OCDMK_CORE
```

## boards/ocdmk/ocdmk_core/Kconfig.ocdmk_core
```kconfig
# OCDMK Core Board Configuration
# Copyright (c) 2024 OCDMK Contributors
# SPDX-License-Identifier: MIT

config BOARD_OCDMK_CORE
    select SOC_NRF52833_QIAA
    imply RETAINED_MEM
    imply RETENTION
    imply RETENTION_BOOT_MODE

config OCDMK_DEBUG
    bool "Enable OCDMK debug logging (RTT + stack diagnostics)"
    default n
```

## boards/shields/ocdmk/Kconfig.defconfig
```kconfig
if SHIELD_OCDMK_LEFT

config ZMK_KEYBOARD_NAME
    default "ocdmk"

config ZMK_SPLIT_ROLE_CENTRAL
    default y

endif # SHIELD_OCDMK_LEFT

if SHIELD_OCDMK_LEFT || SHIELD_OCDMK_RIGHT

config ZMK_SPLIT
    default y

config ZMK_BACKLIGHT
    default y
    select PWM
    select LED_PWM

endif # SHIELD_OCDMK_LEFT || SHIELD_OCDMK_RIGHT
```

## dts/bindings/zmk,behavior-bootloader.yaml
```yaml
description: >
  Jump to bootloader: writes 0x57 (USB UF2) or 0xA8 (OTA BLE DFU) to
  GPREGRET depending on whether CONFIG_ZMK_BLE is set, then warm-reboots.

compatible: "zmk,behavior-bootloader"

include: zero_param.yaml
```

## dts/bindings/zmk,indicator-led.yaml
```yaml
# Copyright (c) 2024 OCDMK Contributors
# SPDX-License-Identifier: MIT

description: |
  Indicator LED driver.
  Blinks on startup, blinks when battery < 20% and not charging.
  Uses BQ25185 STAT1/STAT2 pins for charge status detection.

compatible: "zmk,indicator-led"

properties:
  led-gpios:
    type: phandle-array
    required: true
    description: GPIO connected to LED output (active high)

  stat1-gpios:
    type: phandle-array
    required: true
    description: GPIO connected to STAT1 input from charger

  stat2-gpios:
    type: phandle-array
    required: true
    description: GPIO connected to STAT2 input from charger
```
